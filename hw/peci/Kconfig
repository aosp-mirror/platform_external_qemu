## hw/sensor/Kconfig
```kconfig
config TMP105
    bool
    depends on I2C
    default y if I2C_DEVICES

config TMP421
    bool
    depends on I2C
    default y if I2C_DEVICES

config DPS310
    bool
    depends on I2C
    default y if I2C_DEVICES

config EMC141X
    bool
    depends on I2C
    default y if I2C_DEVICES

config ADM1272
    bool
    depends on I2C

config ADM1266
    bool
    depends on PMBUS
    default y if PMBUS

config ADP1050
    bool
    depends on I2C

config MAX34451
    bool
    depends on I2C

config LSM303DLHC_MAG
    bool
    depends on I2C
    default y if I2C_DEVICES

config ISL_PMBUS_VR
    bool
    depends on PMBUS

config MAX31785
    bool
    depends on PMBUS

config AMDSBTSI
    bool
    depends on I2C

config MAX_16600
    bool
    depends on I2C

config MAX31760
    bool
    depends on I2C
    default y if I2C_DEVICES

config MAX31790
    bool
    depends on I2C

config MAX20730
    bool
    depends on I2C

config DELTA_U50SU8P167
    bool
    depends on I2C

config TDA387XX
    bool
    depends on I2C
    default y if I2C_DEVICES
```
